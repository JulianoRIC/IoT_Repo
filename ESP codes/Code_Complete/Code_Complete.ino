//Adicionando bibliotecas
#include <Arduino.h>
#include <IRremoteESP8266.h>
#include <IRsend.h>
//#include <ESP8266WiFi.h>
//#include <ESP8266Ping.h>
#include <WiFi.h>
#include <ArduinoJson.h>
#include <PubSubClient.h>
#include <Time.h>
//#include<ADS1115_WE.h> 
#include<Wire.h>2
#include "DHT.h"
#include "EmonLib.h"
#include <String.h>

EnergyMonitor emon1;
int rede = 220;
//Pino do sensor SCT
int pino_sct = 36;

char* ssid = "LMM";
char* password =  "mecatronica";
const char* mqttServer = "192.168.1.106";
const int mqttPort = 1883;
const char* mqttUser = "grupo4";
const char* mqttPassword = "grupo4_22";
const char* topic_in = "comandos";
const char* topic_out = "teste";

WiFiClient espClient; 
PubSubClient client(espClient);


const uint16_t kIrLed = 4;  // ESP8266 GPIO pin to use. Recommended: 4 (D2).
IRsend irsend(kIrLed);  // Set the GPIO to be used to sending the message.

uint16_t poweroff[] = {2886, 1854,  380, 1166,  354, 1192,  354, 470,  332, 494,  380, 446,  380,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 1184,  378};  // UNKNOWN C8080FBE

uint16_t set_temp_16[] = {2956, 1780, 408, 1164, 380, 1108, 436, 444, 380, 444, 380, 444, 380,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 456, 384 };  // UNKNOWN E06265AC

uint16_t set_temp_17[] = {2936, 1824, 360, 1128, 440, 1160, 360, 468, 356, 468, 356, 468, 380,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 460, 380};  // UNKNOWN 6911692E

uint16_t set_temp_18[] = {2932, 1748, 464, 1080, 464, 1112, 432, 420, 404, 420, 404, 416, 408,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 456, 384}; 

uint16_t set_temp_19[] = {2940, 1800, 408, 1160, 384, 1160, 384, 444, 380, 444, 380, 444, 380,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 456, 384 }; 

uint16_t set_temp_20[] = {2928, 1780, 408, 1136, 408, 1136, 408, 444, 380, 444, 380, 416, 408,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 456, 384};

uint16_t set_temp_21[] = {2886, 1856,  380, 1140,  380, 1166,  402, 446,  356, 468,  356, 470,  356,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 440,  378};  // UNKNOWN F471A71D

uint16_t set_temp_22[] = {2908, 1834,  382, 1164,  382, 1164,  382, 442,  380, 444,  380, 444,  380,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 408,  408};  // TEKNOPOINT

uint16_t set_temp_23[] = {2936, 1804,  384, 1164,  406, 1140,  382, 444,  382, 442,  380, 444,  382,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 462,  380};  // TEKNOPOINT

uint16_t set_temp_24[] = {2900, 1842,  346, 1174,  372, 1176,  368, 430,  398, 426,  398, 426,  400,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 408,  432};  // UNKNOWN D423A106

uint16_t set_temp_25[] = {2962, 1778,  432, 1116,  406, 1136,  408, 444,  382, 442,  380, 444,  380,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 464,  378};  // TEKNOPOINT



uint16_t powerOn[] =  {2938, 1784,  326, 1218,  328, 1218,  378, 444,  380, 446,  404, 420,  404,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 1210,  352};  // UNKNOWN 2D337BE8

#define DHTPIN 5            // pino do DHT11
#define DHTTYPE DHT11       // tipo do sensor: DHT 11
DHT dht(DHTPIN, DHTTYPE);

float temperatura_ambiente = 23;
float tempAnt;
float umidade_relativa;
// Sensor de presenca
int pinopir = 12; //Pino ligado ao sensor PIR

void setup() {
  irsend.begin();
  pinMode(pinopir, INPUT);
  Serial.begin(9600);
    //Pino, calibracao - Cur Const= Ratio/BurdenR. 2000/33 = 60
  emon1.current(pino_sct, 60);
  WiFi.begin(ssid, password);
  while (WiFi.status() != WL_CONNECTED) {
  delay(500);
  Serial.println("Connecting to WiFi..");
  }
  Serial.println("Connected to the WiFi network");

    client.setServer(mqttServer, mqttPort);
  client.setCallback(callback);
 
  while (!client.connected()) {
    Serial.println("Connecting to MQTT...");
 
    if (client.connect("ESP8266Client", mqttUser, mqttPassword )) {
 
      Serial.println("connected");  
 
    } else {
 
      Serial.print("failed with state ");
      Serial.print(client.state());
      delay(2000);
 
    }
  }

  client.subscribe("iot/comandos");
}

void callback(char* topic_in, byte* message, unsigned int length) {

  String message_in;
  Serial.print("Message arrived in topic: ");
  Serial.println(topic_in);
 
  Serial.print("Message:");
  for (int i = 0; i < length; i++) {
    Serial.print((char)message[i]);
    message_in += (char)message[i];
  }

/*  switch (message_in) {
  case "on":
    Serial.println("set on");
    ac_PowerOn();
    delay(500);     
    break;
  case "off":
    Serial.println("set off");
    ac_PowerOff(); 
    break;
  case "21":
    Serial.println("set 21");
    ac_setTemp21();
    break;   
  case "22":
    Serial.println("set 22");
    ac_setTemp22();
    break;    
  case "23":
    Serial.println("set 23");
    ac_setTemp23();
    break;    
   case "24":
    Serial.println("set 24");
    ac_setTemp24();
    break;    
   case "25":
    Serial.println("set 25");
    ac_setTemp25();
    break;                
  default:
    // Se nenhum dos anteriores, faz o caso padrão default
    // default é opcional
    break;
  }*/

  if(message_in == "on"){
    Serial.println("set on");
    ac_PowerOn();
    delay(500);     
  }
  if(message_in == "off"){
    Serial.println("set off");
    ac_PowerOff();
  }
    if(message_in == "16"){
    Serial.println("set 16");
    ac_setTemp16();
  }
    if(message_in == "17"){
    Serial.println("set 17");
    ac_setTemp17();
  }
      if(message_in == "18"){
    Serial.println("set 18");
    ac_setTemp18();
  }
      if(message_in == "19"){
    Serial.println("set 19");
    ac_setTemp19();
  }
      if(message_in == "20"){
    Serial.println("set 20");
    ac_setTemp20();
  }
    if(message_in == "21"){
    Serial.println("set 21");
    ac_setTemp21();
  }
    if(message_in == "22"){
    Serial.println("set 22");
    ac_setTemp22();
  }
    if(message_in == "23"){
    Serial.println("set 23");
    ac_setTemp23();
  }
    if(message_in == "24"){
    Serial.println("set 24");
    ac_setTemp24();
  }
    if(message_in == "25"){
    Serial.println("set 25");
    ac_setTemp25();
  }
  Serial.println();
  Serial.println("-----------------------");
 
}

void ac_PowerOn(){
    irsend.sendRaw(poweroff, sizeof(poweroff) / sizeof(poweroff[0]), 38);  // Send a raw data capture at 38kHz.
    delay(100);
    Serial.println("Comando de ligar enviado");  
}

void ac_PowerOff(){
    irsend.sendRaw(powerOn, sizeof(powerOn) / sizeof(powerOn[0]), 38);  // Send a raw data capture at 38kHz.
    delay(100);
    Serial.println("Comando de desligar enviado");  
}

void ac_setTemp16(){
    irsend.sendRaw(set_temp_16, sizeof(set_temp_16) / sizeof(set_temp_16[0]), 38);  // Send a raw data capture at 38kHz.  
    delay(100);
    Serial.println("Comando de alterar a temperatura para 16ºC enviado.");  
}

void ac_setTemp17(){
    irsend.sendRaw(set_temp_17, sizeof(set_temp_17) / sizeof(set_temp_17[0]), 38);  // Send a raw data capture at 38kHz.  
    delay(100);
    Serial.println("Comando de alterar a temperatura para 17ºC enviado.");  
}

void ac_setTemp18(){
    irsend.sendRaw(set_temp_18, sizeof(set_temp_18) / sizeof(set_temp_18[0]), 38);  // Send a raw data capture at 38kHz.  
    delay(100);
    Serial.println("Comando de alterar a temperatura para 18ºC enviado.");  
}

void ac_setTemp19(){
    irsend.sendRaw(set_temp_19, sizeof(set_temp_19) / sizeof(set_temp_19[0]), 38);  // Send a raw data capture at 38kHz.  
    delay(100);
    Serial.println("Comando de alterar a temperatura para 19ºC enviado.");  
}

void ac_setTemp20(){
    irsend.sendRaw(set_temp_20, sizeof(set_temp_20) / sizeof(set_temp_20[0]), 38);  // Send a raw data capture at 38kHz.  
    delay(100);
    Serial.println("Comando de alterar a temperatura para 20ºC enviado.");  
}
void ac_setTemp21(){
    irsend.sendRaw(set_temp_21, sizeof(set_temp_21) / sizeof(set_temp_21[0]), 38);  // Send a raw data capture at 38kHz.  
    delay(100);
    Serial.println("Comando de alterar a temperatura para 21ºC enviado.");  
}

void ac_setTemp22(){
    irsend.sendRaw(set_temp_22, sizeof(set_temp_22) / sizeof(set_temp_22[0]), 38);  // Send a raw data capture at 38kHz.  
    delay(100);
    Serial.println("Comando de alterar a temperatura para 22ºC enviado.");  
}

void ac_setTemp23(){
    irsend.sendRaw(set_temp_23, sizeof(set_temp_23) / sizeof(set_temp_23[0]), 38);  // Send a raw data capture at 38kHz.  
    delay(100);
    Serial.println("Comando de alterar a temperatura para 23ºC enviado.");  
}

void ac_setTemp24(){
    irsend.sendRaw(set_temp_24, sizeof(set_temp_24) / sizeof(set_temp_24[0]), 38);  // Send a raw data capture at 38kHz.  
    delay(100);
    Serial.println("Comando de alterar a temperatura para 24ºC enviado.");  
}

void ac_setTemp25(){
    irsend.sendRaw(set_temp_25, sizeof(set_temp_25) / sizeof(set_temp_25[0]), 38);  // Send a raw data capture at 38kHz.  
    delay(100);
    Serial.println("Comando de alterar a temperatura para 25ºC enviado.");  
}

float pega_temperatura()
{
  float temp =  dht.readTemperature();
  tempAnt = temperatura_ambiente; 

  if (isnan(temp) || (temp < 0) || (temp > 50))
  {
    Serial.println("Falha ao ler o DHT");
    temperatura_ambiente = tempAnt;
  }
  else
  {
    if ((abs(tempAnt - temp))< 5){
      temperatura_ambiente = temp;
    }
  }
  return temperatura_ambiente; 
}

void pega_umidade()
{
  float umd = dht.readHumidity();
  if (isnan(umd))
  {
    Serial.println("Falha ao ler o DHT");
  }
  else
  {
    umidade_relativa = umd;
  }
}

void loop() {

  while (WiFi.status() != WL_CONNECTED) {
    delay(500);
    Serial.println("Connecting to WiFi..");
  }

   while (!client.connected()) {
    Serial.println("Connecting to MQTT...");
 
    if (client.connect("ESP8266Client", mqttUser, mqttPassword )) {
 
      Serial.println("connected");  
 
    } else {
 
      Serial.print("failed with state ");
      Serial.print(client.state());
      delay(2000);
 
    }
  }
 //Calcula a corrente
 double Irms = emon1.calcIrms(1480)/10;
  float co2 = random(3400, 3700)/100;
  float cor = 0;

  if (((Irms > 1.3)&&(Irms < 15))){
    cor = Irms;
    }

  float pot = cor*rede;                                                                              
  float t = pega_temperatura(); 
  Serial.println(t);
  String payload = "&";
 
  payload += t; payload += "&";
  payload += co2; payload += "&";
  payload += pot; payload += "&";
  payload += cor; payload += "&";
 
  // Send payload to MQTT

  char mensagem[300];
  payload.toCharArray(mensagem, 300 );
  
  client.loop();
  client.publish("iot/teste", mensagem);
  delay(3000);
}
